## Kconfig
```kconfig
mainmenu "RT-Thread Configuration"

BSP_DIR := .

RTT_DIR := rt-thread

PKGS_DIR := packages

menu "RT-Thread"
osource "$RTT_DIR/Kconfig"
endmenu

source "../libraries/Kconfig"
if !RT_USING_NANO
source "board/Kconfig"
endif
osource "$PKGS_DIR/Kconfig"
orsource "./packages/Kconfig"
orsource "./applications/Kconfig"
```

## applications/rescue_robot/Kconfig
```kconfig
config APP_RESCUE_ROBOT
    bool "救援机器人"
    default n
    select PKG_USING_CFF_ALGORITHM_LIBRARY
    select ALGORITHM_USING_CHASSIS_SOLVE

if APP_RESCUE_ROBOT

endif
```

## boards/stm32/MFMaster1/board/Kconfig
```kconfig
menu "MFMasterV1 Hardware Drivers Config"

config CFF_MF_MASTER_1
    bool
    default y

config SOC_STM32F407VE
    bool
    select SOC_SERIES_STM32F4
    select RT_USING_COMPONENTS_INIT
    select RT_USING_USER_MAIN
    default y

menu "On-chip Peripheral Drivers"

    config BSP_USING_GPIO
        bool "Enable GPIO"
        select RT_USING_PIN
        default y

    config BSP_USING_ON_CHIP_FLASH
        bool "Enable on-chip FLASH"
        default n

    menuconfig BSP_USING_UART
        bool "Enable UART"
        default y
        select RT_USING_SERIAL
        if BSP_USING_UART
            menuconfig BSP_USING_UART1
                bool "Enable UART1"
                default y
                if BSP_USING_UART1
                    config BSP_UART1_RX_USING_DMA
                        bool "Enable UART1 RX DMA"
                        depends on BSP_USING_UART1 && RT_SERIAL_USING_DMA
                        default n

                    config BSP_UART1_TX_USING_DMA
                        bool "Enable UART1 TX DMA"
                        depends on BSP_USING_UART1 && RT_SERIAL_USING_DMA
                        default n

                    config BSP_UART1_RX_BUFSIZE
                        int "Set UART1 RX buffer size"
                        range 64 65535
                        depends on RT_USING_SERIAL_V2
                        default 256

                    config BSP_UART1_TX_BUFSIZE
                        int "Set UART1 TX buffer size"
                        range 0 65535
                        depends on RT_USING_SERIAL_V2
                        default 0
                endif

            menuconfig BSP_USING_UART2
                bool "Enable UART2"
                default n
                if BSP_USING_UART2
                    config BSP_UART2_RX_USING_DMA
                        bool "Enable UART2 RX DMA"
                        depends on BSP_USING_UART2 && RT_SERIAL_USING_DMA
                        default n

                    config BSP_UART2_TX_USING_DMA
                        bool "Enable UART2 TX DMA"
                        depends on BSP_USING_UART2 && RT_SERIAL_USING_DMA
                        default n

                    config BSP_UART2_RX_BUFSIZE
                        int "Set UART2 RX buffer size"
                        range 64 65535
                        depends on RT_USING_SERIAL_V2
                        default 256

                    config BSP_UART2_TX_BUFSIZE
                        int "Set UART2 TX buffer size"
                        range 0 65535
                        depends on RT_USING_SERIAL_V2
                        default 0
                endif

            menuconfig BSP_USING_UART3
                bool "Enable UART3"
                default n
                if BSP_USING_UART3
                    config BSP_UART3_RX_USING_DMA
                        bool "Enable UART3 RX DMA"
                        depends on BSP_USING_UART3 && RT_SERIAL_USING_DMA
                        default n

                    config BSP_UART3_TX_USING_DMA
                        bool "Enable UART3 TX DMA"
                        depends on BSP_USING_UART3 && RT_SERIAL_USING_DMA
                        default n

                    config BSP_UART3_RX_BUFSIZE
                        int "Set UART3 RX buffer size"
                        range 64 65535
                        depends on RT_USING_SERIAL_V2
                        default 256

                    config BSP_UART3_TX_BUFSIZE
                        int "Set UART3 TX buffer size"
                        range 0 65535
                        depends on RT_USING_SERIAL_V2
                        default 0
                endif

            menuconfig BSP_USING_UART4
                bool "Enable UART4"
                default n
                if BSP_USING_UART4
                    config BSP_UART4_RX_USING_DMA
                        bool "Enable UART4 RX DMA"
                        depends on BSP_USING_UART4 && RT_SERIAL_USING_DMA
                        default n

                    config BSP_UART4_TX_USING_DMA
                        bool "Enable UART4 TX DMA"
                        depends on BSP_USING_UART4 && RT_SERIAL_USING_DMA
                        default n

                    config BSP_UART4_RX_BUFSIZE
                        int "Set UART4 RX buffer size"
                        range 64 65535
                        depends on RT_USING_SERIAL_V2
                        default 256

                    config BSP_UART4_TX_BUFSIZE
                        int "Set UART4 TX buffer size"
                        range 0 65535
                        depends on RT_USING_SERIAL_V2
                        default 0
                endif
            
            menuconfig BSP_USING_UART5
                bool "Enable UART5"
                default y
                if BSP_USING_UART5
                    config BSP_UART5_RX_USING_DMA
                        bool "Enable UART5 RX DMA"
                        depends on BSP_USING_UART5 && RT_SERIAL_USING_DMA
                        default n

                    config BSP_UART5_TX_USING_DMA
                        bool "Enable UART5 TX DMA"
                        depends on BSP_USING_UART5 && RT_SERIAL_USING_DMA
                        default n

                    config BSP_UART5_RX_BUFSIZE
                        int "Set UART5 RX buffer size"
                        range 64 65535
                        depends on RT_USING_SERIAL_V2
                        default 256

                    config BSP_UART5_TX_BUFSIZE
                        int "Set UART5 TX buffer size"
                        range 0 65535
                        depends on RT_USING_SERIAL_V2
                        default 0
                endif

            menuconfig BSP_USING_UART6
                bool "Enable UART6"
                default n
                if BSP_USING_UART6
                    config BSP_UART6_RX_USING_DMA
                        bool "Enable UART6 RX DMA"
                        depends on BSP_USING_UART6 && RT_SERIAL_USING_DMA
                        default n

                    config BSP_UART6_TX_USING_DMA
                        bool "Enable UART6 TX DMA"
                        depends on BSP_USING_UART6 && RT_SERIAL_USING_DMA
                        default n

                    config BSP_UART6_RX_BUFSIZE
                        int "Set UART6 RX buffer size"
                        range 64 65535
                        depends on RT_USING_SERIAL_V2
                        default 256

                    config BSP_UART6_TX_BUFSIZE
                        int "Set UART6 TX buffer size"
                        range 0 65535
                        depends on RT_USING_SERIAL_V2
                        default 0
                endif
        endif

    menuconfig BSP_USING_CAN
        bool "Enable CAN"
        default n
        select RT_USING_CAN
        if BSP_USING_CAN
            config BSP_USING_CAN1
                bool "using CAN1"
                default n
            config BSP_USING_CAN2
                bool "using CAN2"
                default n
        endif

    menuconfig BSP_USING_SPI
        bool "Enable SPI BUS"
        default n
        select RT_USING_SPI
        if BSP_USING_SPI
            config BSP_USING_SPI1
                bool "Enable SPI1 BUS"
                default n

            config BSP_SPI1_TX_USING_DMA
                bool "Enable SPI1 TX DMA"
                depends on BSP_USING_SPI1
                default n

            config BSP_SPI1_RX_USING_DMA
                bool "Enable SPI1 RX DMA"
                depends on BSP_USING_SPI1
                select BSP_SPI1_TX_USING_DMA
                default n

            config BSP_USING_SPI2
                bool "Enable SPI2 BUS"
                default n

            config BSP_SPI2_TX_USING_DMA
                bool "Enable SPI2 TX DMA"
                depends on BSP_USING_SPI2
                default n

            config BSP_SPI2_RX_USING_DMA
                bool "Enable SPI2 RX DMA"
                depends on BSP_USING_SPI2
                select BSP_SPI2_TX_USING_DMA
                default n
        endif

        

    menuconfig BSP_USING_I2C1
        bool "Enable I2C1 BUS (software simulation)"
        default n
        select RT_USING_I2C
        select RT_USING_I2C_BITOPS
        select RT_USING_PIN
        if BSP_USING_I2C1
            comment "Notice: PB3 --> 19; PB4 --> 20"
            config BSP_I2C1_SCL_PIN
                int "i2c1 scl pin number"
                range 0 81
                default 19
            config BSP_I2C1_SDA_PIN
                int "I2C1 sda pin number"
                range 0 81
                default 20
        endif

    menuconfig BSP_USING_TIM
        bool "Enable timer"
        default n
        select RT_USING_HWTIMER
        if BSP_USING_TIM
            config BSP_USING_TIM11
                bool "Enable TIM11"
                default n

            config BSP_USING_TIM13
                bool "Enable TIM13"
                default n

            config BSP_USING_TIM14
                bool "Enable TIM14"
                default n
        endif

    menuconfig BSP_USING_PWM
        bool "Enable PWM"
        default n
        select RT_USING_PWM
        if BSP_USING_PWM
            menuconfig BSP_USING_PWM1
            bool "Enable timer1 output PWM"
            default n
            if BSP_USING_PWM1
                config BSP_USING_PWM1_CH1
                    bool "Enable PWM1 channel1"
                    default n
                config BSP_USING_PWM1_CH2
                    bool "Enable PWM1 channel2"
                    default n
                config BSP_USING_PWM1_CH3
                    bool "Enable PWM1 channel3"
                    default n
                config BSP_USING_PWM1_CH4
                    bool "Enable PWM1 channel4"
                    default n
            endif

            menuconfig BSP_USING_PWM2
            bool "Enable timer2 output PWM"
            default n
            if BSP_USING_PWM2
                config BSP_USING_PWM2_CH1
                    bool "Enable PWM2 channel1"
                    default n
                config BSP_USING_PWM2_CH2
                    bool "Enable PWM2 channel2"
                    default n
                config BSP_USING_PWM2_CH3
                    bool "Enable PWM2 channel3"
                    default n
                config BSP_USING_PWM2_CH4
                    bool "Enable PWM2 channel4"
                    default n
            endif

            menuconfig BSP_USING_PWM3
            bool "Enable timer3 output PWM"
            default n
            if BSP_USING_PWM3
                config BSP_USING_PWM3_CH1
                    bool "Enable PWM3 channel1"
                    default n
                config BSP_USING_PWM3_CH2
                    bool "Enable PWM3 channel2"
                    default n
                config BSP_USING_PWM3_CH3
                    bool "Enable PWM3 channel3"
                    default n
                config BSP_USING_PWM3_CH4
                    bool "Enable PWM3 channel4"
                    default n
            endif

        endif

    menuconfig BSP_USING_ADC
        bool "Enable ADC"
        default n
        select RT_USING_ADC
        if BSP_USING_ADC
            config BSP_USING_ADC1
                bool "Enable ADC1"
                default n
        endif

    menuconfig BSP_USING_ONCHIP_RTC
        bool "Enable RTC"
        select RT_USING_RTC
        default n
        if BSP_USING_ONCHIP_RTC
            choice
                prompt "Select clock source"
                default BSP_RTC_USING_LSE

                config BSP_RTC_USING_LSE
                    bool "RTC USING LSE"

                config BSP_RTC_USING_LSI
                    bool "RTC USING LSI"
            endchoice
        endif

    config BSP_USING_WDT
        bool "Enable Watchdog Timer"
        select RT_USING_WDT
        default n
        
    source "$(BSP_DIR)/../libraries/HAL_Drivers/drivers/Kconfig"

endmenu

menu "Board extended module Drivers"
    config BSP_USING_USB
        bool "Enable USB Device/Host"
        select PKG_USING_CFF_TEENYUSB
        default n

    config BSP_USING_BEEP
        bool "Enable Beep (pwm1 ch4)"
        select BSP_USING_PWM
        select BSP_USING_PWM1
        select BSP_USING_PWM1_CH4
        default n

    config BSP_USING_SPI_FLASH
        bool "Enable SPI FLASH (W25Q64 spi2)"
        select BSP_USING_SPI
        select BSP_USING_SPI2
        select BSP_USING_ON_CHIP_FLASH
        select RT_USING_SFUD
        select RT_SFUD_USING_SFDP
        select RT_USING_FAL
        select PKG_USING_EASYFLASH
        default n
        if BSP_USING_SPI_FLASH
            config FLASH_MOUNT_SPI_DEVICE_NAME
                string "Flash mount the spi device name"
                default "spiflash"

            config FAL_USING_NOR_FLASH_DEV_NAME
                string "The name of the device used by FAL"
                default "W25Q64"
        endif

    config BSP_USING_BMI088
        bool "Enable gyro (BMI088)"
        select BSP_USING_SPI
        select BSP_USING_SPI1
        select BSP_USING_GPIO
        select PKG_USING_CFF_BMI08x
        select BMI08x_DRIVE_USING_BMI088
        default n

    config BSP_USING_KEYPAD
        bool "Enable KEYPAD"
        select PKG_USING_AGILE_BUTTON
        default n

    config BSP_USING_ST7789
        bool "Enable LCD (Use ST7789)"
        select BSP_USING_SPI
        select BSP_USING_SPI1
        select BSP_USING_GPIO
        select PKG_USING_CFF_LCD
        select CONFIG_LCD_DRIVE_ST7789
        default n

    choice
        prompt "Extended function backboard"
        default BSP_USING_EXTBOARD_JY

        config BSP_USING_EXTBOARD_JY
        bool "救援拓展底板"
        select BSP_USING_GPIO
        select BSP_USING_UART
        select BSP_USING_UART1
        select BSP_USING_UART2
        select BSP_USING_UART3
        select BSP_USING_UART4
        select BSP_USING_UART6
        
    endchoice
        
endmenu

endmenu
```
