## packages/CFF-packages/Actuator/CAN_Communication/Kconfig
```kconfig
# Kconfig file for package CAN_Communication
menuconfig PKG_USING_CFF_CAN_COMMUNICATION
    bool "创非凡® CAN 通信协议层"
    select BSP_USING_CAN
    default n

if PKG_USING_CFF_CAN_COMMUNICATION

    config CFFCAN_DC_MOTOR_MINIWATT
        bool "DC Motor"
        default n
        if CFFCAN_DC_MOTOR_MINIWATT
            choice
                prompt "Quadrature Encoded Pulses or Input capture"
                default QEP_DC_MOTOR
                config QEP_DC_MOTOR
                    bool "Quadrature Encoded Pulses"
                config INPUT_CAPTURE_MOTOR
                    bool "Input capture"
            endchoice
        endif

    config CFFCAN_STEERING_ENGINE_6CH
        bool "6通道舵机模块"
        default n

    config CFFCAN_STEERING_ENGINE_3CH
        bool "3通道总线舵机模块"
        default n

    config CFFCAN_STEERING_MOTOR
        bool "步进电机模块"
        default n


    config CFFCAN_EXPANSION_BOARD_INPUT
        bool "输入拓展模块"
        default n

    config CFFCAN_EXPANSION_BOARD_OUT
        bool "输出拓展模块"
        default n

    config CFFCAN_TRACKING_SENSOR
        bool "巡线模块"
        default n

    config CFFCAN_ULTRASONIC_RANGING_SENSOR
        bool "超声波测距模块"
        default n
        
endif
```

## packages/CFF-packages/Actuator/Motor/BusServoMotor/Kconfig
```kconfig
# Kconfig file for package BusServo
menuconfig PKG_USING_CFF_BUS_SERVO
    bool "创非凡® 总线舵机"
    select BSP_USING_UART
    select PKG_USING_ALGORITHM_LIBRARY
    select PKG_USING_CFF_SERIAL_BUS
    default n
```

## packages/CFF-packages/Peripheral/Kconfig
```kconfig
orsource "./st77xx/Kconfig"
orsource "./TeenyUSB/Kconfig"
orsource "./bmi08x/Kconfig"
orsource "./TonePlayer/Kconfig"
```

## packages/CFF-packages/Peripheral/TM16xx/Kconfig
```kconfig
menuconfig EXT_USING_TM16XX_LIBRARY
    bool "TM16xx LEDs and Buttons library"
    depends on BSP_USING_GPIO
    select RT_USING_CPLUSPLUS
    default n

if EXT_USING_TM16XX_LIBRARY
    
    config TM16XX_USING_TM1652_DRIVER
        bool "TM1652"
        default n

endif
```

## packages/CFF-packages/Peripheral/TeenyUSB/Kconfig
```kconfig
# Kconfig file for package TeenyUSB
menuconfig PKG_USING_CFF_TEENYUSB
    bool "TeenyUSB: A teeny USB device and host stack for MCUs, support super speed device."
    default n
    select RT_USING_USB
    select RT_USING_EVENT
    select RT_USING_MESSAGEQUEUE

if PKG_USING_CFF_TEENYUSB

    choice
        prompt "USB OTG (FS/HS) Core"
        default TEENYUSB_OTG_FS

        config TEENYUSB_OTG_FS
            bool "USB Full Speed (FS) Core"

        config TEENYUSB_OTG_HS
            bool "USB High Speed (HS) Core"
    endchoice

    choice
        prompt "Port speed"
        default TEENYUSB_FULL_SPEED

        config TEENYUSB_FULL_SPEED
            bool "Full Speed"

        config TEENYUSB_HIGH_SPEED
            depends on TEENYUSB_HS
            bool "High Speed"
    endchoice

    menuconfig TEENYUSB_HOST_ENABLE
        bool "Using USB host"
        default n

    if TEENYUSB_HOST_ENABLE
        config TEENYUSB_USBH_HUB
            bool "support multiple device and hub"
            default n

        config TEENYUSB_USBH_HID
            bool "Human interface device (HID)"
            default n

        config TEENYUSB_USBH_MSC
            bool "Mass storage class with BOT protocol (MSC)"
            default n

        #config TEENYUSB_USBH_CDC_ACM
        #    bool "Communication device class, abstract control mode (ACM)"
        #    default n

        #config TEENYUSB_USBH_CDC_RNDIS
        #    bool "Communication device class, remote NDIS (RNDIS)"
        #    default n

        #config TEENYUSB_USBH_VENDOR
        #    bool "Vendor class"
        #    default n
    endif

    menuconfig TEENYUSB_DEVICE_ENABLE
        bool "Using USB device"
        default n

    if TINYUSB_DEVICE_ENABLE

    endif

    config TEENYUSB_DESCRIPTOR_BUFFER_SIZE
        int "descriptor buffer, some device require data in RAM"
        default 256

    choice
        prompt "TeenyUSB debug info level"
        default TEENYUSB_DBG_DEBUG

        config TEENYUSB_DBG_DEBUG
            bool "Debug"
        config TEENYUSB_DBG_WARNING
            bool "Warning"
        config TEENYUSB_DBG_ERROR
            bool "Error"
        config TEENYUSB_DBG_NONE
            bool "None"
    endchoice


endif
```

## packages/CFF-packages/Peripheral/st77xx/Kconfig
```kconfig
menuconfig PKG_USING_CFF_LCD
    bool "LCD drivers"
    depends on BSP_USING_SPI && BSP_USING_GPIO
    default n

if PKG_USING_CFF_LCD

    choice
        prompt "LCD Drive"
        default CONFIG_LCD_DRIVE_ST7735

        config CONFIG_LCD_DRIVE_ST7735
            bool "ST7735 Drive"

        config CONFIG_LCD_DRIVE_ST7789
            bool "ST7789 Drive"

    endchoice

    config CONFIG_LCD_SPI_BUS_NAME
        string "LCD use the SPI bus"
        default "spi1"

    config CONFIG_LCD_MOUNT_SPI_DEVICE_NAME
        string "LCD mount the spi device name"
        default "spilcd"

    #config CONFIG_LCD_SPI_CS_PIN
    #    int "LCD chipselect(NSS/CS) pin number"
    #    default 35

    #config CONFIG_LCD_DC_PIN
    #    int "LCD DC(RS) pin number"
    #    default 36
    
    #menuconfig CONFIG_LCD_USING_RESET_PIN
    #    bool "Enable lcd reset pin"
    #    default n
    #    if CONFIG_LCD_USING_RESET_PIN
    #        config CONFIG_LCD_RESET_PIN
    #            int "LCD reset pin number"
    #            default 37
    #    endif

    #menuconfig CONFIG_LCD_USING_BL_PIN
    #    bool "Enable lcd backlight pin"
    #    default n
    #    if CONFIG_LCD_USING_BL_PIN
    #        config CONFIG_LCD_BL_PIN
    #            int "LCD backlight pin number"
    #            default 38
    #    endif

    choice
        prompt "LCD display orientation"
        default CONFIG_LCD_VERTICAL

        config CONFIG_LCD_VERTICAL
            bool "Vertical"
        config CONFIG_LCD_VERTICAL_INVERTED
            bool "Vertical inverted"
        config CONFIG_LCD_HORIZONTAL
            bool "Horizontal"
        config CONFIG_LCD_HORIZONTAL_INVERTED
            bool "Horizontal inverted"
    endchoice

    config CONFIG_LCD_DISPLAY_ORIENTATION
        int
        default 0 if CONFIG_LCD_VERTICAL
        default 1 if CONFIG_LCD_VERTICAL_INVERTED
        default 2 if CONFIG_LCD_HORIZONTAL
        default 3 if CONFIG_LCD_HORIZONTAL_INVERTED
        default 0

    menu "LCD Font"
        config CONFIG_LCD_FONT_ASC2_1608
            bool "ASC2_1608"
            default y

        config CONFIG_LCD_FONT_ASC2_2412
            bool "ASC2_2412"
            default n

        config CONFIG_LCD_FONT_ASC2_3216
            bool "ASC2_3216"
            default n

        config CONFIG_LCD_FONT_ASC2_4824
            bool "ASC2_4824"
            default n

        config CONFIG_LCD_FONT_ASC2_6432
            bool "ASC2_6432"
            default n
    endmenu
endif
```

## packages/Kconfig
```kconfig
menu "Custom function supplement package"

# 创非凡功能包
orsource "./CFF-packages/Kconfig"

endmenu
```

## 涵道源代码/applications/Kconfig
```kconfig
choice
prompt "XRobot Applications"

rsource "./rescue_robot/Kconfig"

endchoice
```

## 涵道源代码/applications/rescue_robot/Kconfig
```kconfig
config APP_RESCUE_ROBOT
    bool "救援机器人"
    default n
    select PKG_USING_CFF_ALGORITHM_LIBRARY
    select ALGORITHM_USING_CHASSIS_SOLVE

if APP_RESCUE_ROBOT
    choice
        prompt "请选择底盘类型"
        default ROBOT_CHASSIS_OMNI

        config ROBOT_CHASSIS_OMNI
            bool "全向轮底盘"

        config ROBOT_CHASSIS_THREE_WHEEL_OMNI
            bool "三轮全向轮底盘"

        config ROBOT_CHASSIS_TWO_DIFF
            bool "两轮差速底盘"

        config ROBOT_CHASSIS_FOUR_DIFF
            bool "四轮差速底盘"

    endchoice

    choice
        prompt "请选择执行机构"
        default ROBOT_STRUCTURE_SUCTION_CUP

        config ROBOT_STRUCTURE_SUCTION_CUP
            bool "吸盘"

        config ROBOT_STRUCTURE_CLAMP
            bool "夹抓"

        config ROBOT_STRUCTURE_DUCTED_FAN
            bool "涵道风扇"
            select SWITCHGEAR_4_USE_PWM

        config ROBOT_STRUCTURE_CATAPULT
            bool "弹射机构"
            select SWITCHGEAR_6_CATAPULT

    endchoice

    config SWITCHGEAR_4_USE_PWM
        bool "外设通道4使能PWM模式"
        default n

    config SWITCHGEAR_6_CATAPULT
        bool "外设通道6使能弹射机构模式"
        default n

endif
```

## 涵道源代码/configs/rescue_robot/defconfig
```kconfig
# CONFIG_RT_USING_DFS is not set
CONFIG_BSP_UART4_RX_USING_DMA=y
# CONFIG_BSP_USING_UART5 is not set
CONFIG_BSP_UART6_RX_USING_DMA=y
CONFIG_BSP_USING_PWM1_CH1=y
CONFIG_BSP_USING_PWM1_CH2=y
CONFIG_BSP_USING_PWM1_CH3=y
CONFIG_BSP_USING_PWM2=y
CONFIG_BSP_USING_PWM2_CH1=y
CONFIG_BSP_USING_PWM2_CH2=y
CONFIG_BSP_USING_USB=y
CONFIG_BSP_USING_BEEP=y
CONFIG_BSP_USING_SPI_FLASH=y
CONFIG_BSP_USING_BMI088=y
CONFIG_BSP_USING_ST7789=y
CONFIG_PKG_CMSIS_DSP_FAST_MATH=y
CONFIG_PKG_USING_CMSIS_DSP=y
CONFIG_ALGORITHM_USING_CHASSIS_KINEMATICS=y
CONFIG_ALGORITHM_USING_PID=y
CONFIG_ALGORITHM_USING_AHRS=y
CONFIG_ALGORITHM_USING_AHRS_MADGWICK=y
CONFIG_ALGORITHM_USING_AHRS_MAHONY=y
CONFIG_CONFIG_LCD_DRIVE_ST7789=y
CONFIG_TEENYUSB_HOST_ENABLE=y
CONFIG_TEENYUSB_USBH_HID=y
CONFIG_PKG_USING_CFF_TONE_PLAYER=y
CONFIG_PKG_USING_CFF_BUS_SERVO=y
CONFIG_PKG_USING_CFF_HUB_MOTOR=y
CONFIG_APP_RESCUE_ROBOT=y
CONFIG_SWITCHGEAR_4_USE_PWM=y
```

## 涵道源代码/packages/CFF-packages/Actuator/Motor/HubMotor/Kconfig
```kconfig
# Kconfig file for package hub_motor
menuconfig PKG_USING_CFF_HUB_MOTOR
    bool "创非凡® 轮毂电机"
    select BSP_USING_UART
    select PKG_USING_CFF_SERIAL_BUS
    default n
```

## 涵道源代码/packages/CFF-packages/Kconfig
```kconfig
menu "CFF packages"

    menu "System"
        rsource "./System/Kconfig"
    endmenu

    menu "LIB"
        rsource "./Lib/Kconfig"
    endmenu

    menu "Peripheral"
        rsource "./Peripheral/Kconfig"
    endmenu

    menu "Actuator"
        rsource "./Actuator/Kconfig"
    endmenu

endmenu
```

## 涵道源代码/packages/CFF-packages/Lib/Algorithms/Kconfig
```kconfig
menuconfig PKG_USING_CFF_ALGORITHM_LIBRARY
    bool "CFF Algorithms library"
    select RT_USING_CPLUSPLUS
    default y

if PKG_USING_CFF_ALGORITHM_LIBRARY

    config ALGORITHM_USING_CHASSIS_KINEMATICS
        bool "Chassis Kinematics library"
        default n

    config ALGORITHM_USING_PID
        bool "PID Controller library"
        default n

    config ALGORITHM_USING_AHRS
        bool "AHRS library"
        default n
        if ALGORITHM_USING_AHRS
                config ALGORITHM_USING_AHRS_MADGWICK
                    bool "Madgwick's IMU and AHRS algorithms."
                    default n

                config ALGORITHM_USING_AHRS_MAHONY
                    bool "Mayhony's AHRS algorithm."
                    default n

            endif

endif
```

## 涵道源代码/packages/CFF-packages/Peripheral/TonePlayer/Kconfig
```kconfig
menuconfig PKG_USING_CFF_TONE_PLAYER
    bool "Buzzer music player"
    select RT_USING_CPLUSPLUS
    default n

if PKG_USING_CFF_TONE_PLAYER


endif
```

## 涵道源代码/packages/CFF-packages/Peripheral/bmi08x/Kconfig
```kconfig
# Kconfig file for package bmi08x
menuconfig PKG_USING_CFF_BMI08x
    bool "Sensor Driver for BMI08x family of sensors."
    select RT_USING_SENSOR
    select RT_USING_SENSOR_V2
    default n

if PKG_USING_CFF_BMI08x

	
endif
```

## 涵道源代码/packages/CFF-packages/Peripheral/wit_imu/Kconfig
```kconfig
menuconfig PKG_USING_CFF_WIT_IMU
    bool "WIT Imu drivers"
    select BSP_USING_UART
    select RT_USING_CPLUSPLUS
    default n

if PKG_USING_CFF_WIT_IMU

    config WIT_IMU_USING_THREAD
        bool "Using thread"
        default y
    
endif
```

## 涵道源代码/packages/CFF-packages/System/Kconfig
```kconfig
rsource "./utils/Kconfig"
orsource "./serial_bus/Kconfig"
orsource "./TinyFrame/Kconfig"
```
